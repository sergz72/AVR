.include "m64def.inc"

;.equ TEST=1

.equ FOSC   = 16000000

.equ T0CODE = FOSC / 8 / 8000 ; 8000 interrupts per second

.equ PWMCODE   = 32
.equ PWM_STOP  = (1<<WGM01) | (1<<WGM00) | (1<<CS00)
.equ PWM_START = (1<<WGM01) | (1<<WGM00) | (1<<COM01) | (1<<CS00)

.equ CNTRL_MAX = 160

.equ REFRESH_FREQ = 50

.equ CORRECTION_VALUE = REFRESH_FREQ/2
.equ CORRECTION_DECREMENT=1

.equ ADC_CHANNEL_0 = 0
.equ ADC_CHANNEL_1 = 1
.equ ADC_CHANNEL_2 = 2
.equ ADC_MIN=374
.equ VREF=2500
.equ VBAT_MAX=8400*1024/4/VREF

.equ DAC_MUL=6;16

.equ MODE_CLOCK = 0
.equ MODE_SET_CLOCK_HOURS = 1
.equ MODE_SET_CLOCK_MINUTES = 2
.equ MODE_SET_DAY_OF_WEEK = 3
.equ MODE_SET_CORRECTION_VALUE = 4
.equ MODE_SET_ALARM_HOURS = 5
.equ MODE_SET_ALARM_MINUTES = 6
.equ MODE_DISPLAY_OFF = 7

.equ RECEIVE_BLOCK_INTERVAL = 4000

.def cntrl=r26
.def cntrh=r27
.def seconds=r25
.def minutes=r24
.def hours=r23
.def day_of_week=r22
.def temph=r21
.def templ=r20
.def mode=r19
.def alarmh=r15
.def alarmm=r14
.def alarm_melody_length_high=r13
.def alarm_melody_length_low=r12
.def phase_table_high=r11
.def phase_table_low=r10
.def adc_channel=r9
.def tmpSREG=r8
.def receive_blocked_counter_h=r7
.def receive_blocked_counter_l=r6
.def receive_counter=r5
.def correction_value_reg=r4

.CSEG

.org 0
  rjmp Start

.org OC2addr
  in  tmpSREG, sreg
  push ZL
  push ZH
  push r16
  push r17
  push r18
  push r0
  push r1
  push r2

  wdr

  tst  receive_blocked_counter_l
  breq next_check
  dec  receive_blocked_counter_l
  rjmp receive_blocked
next_check:
  tst  receive_blocked_counter_h
  breq receive_not_blocked
  dec  receive_blocked_counter_l
  dec  receive_blocked_counter_h
  rjmp receive_blocked

receive_not_blocked:

; ir receiver status
  tst  receive_counter
  brne ir_counter_increment
  sbic PIND, PIND2
  rjmp ir_counter_complete
ir_counter_increment:
  inc  receive_counter
ir_counter_complete:

receive_blocked:

; alarm counter test
  tst alarm_melody_length_low
  brne alarm_melody_out
  tst alarm_melody_length_high
  breq no_alarm_melody_out
; alarm counter decrement
  dec alarm_melody_length_high
alarm_melody_out:
  dec alarm_melody_length_low

; spi out
  cbi PORTB, PORTB0 ; Select DAC

  movw ZH:ZL, YH:YL
  lpm r16, Z+
  movw YH:YL, ZH:ZL
  ldi r17, DAC_MUL
  mul r17, r16
  ; Start transmission of data (r1)
  out SPDR, r1
Wait_Transmit1:
  ; Wait for transmission complete
  sbis SPSR, SPIF
  rjmp Wait_Transmit1
  in   r1, SPDR

  ; Start transmission of data (r0)
  out SPDR, r0
Wait_Transmit2:
  ; Wait for transmission complete
  sbis SPSR, SPIF
  rjmp Wait_Transmit2
  in   r1, SPDR
  sbi PORTB, PORTB0 ; Unselect DAC
  rjmp alarm_out_done

no_alarm_melody_out:
  cbi PORTD, PORTD3 ; Turn OFF amplifier
alarm_out_done:

  inc  cntrl

  ldi  r16, CNTRL_MAX
  cp   cntrh, correction_value_reg
  brlo no_correction
.ifdef CORRECTION_INCREMENT
  inc  r16
.endif
.ifdef CORRECTION_DECREMENT
  dec  r16
.endif

no_correction:
  cp   cntrl, r16
  brne no_cntrl_max
  clr  cntrl
  inc  cntrh
  cpi  cntrh, REFRESH_FREQ
  brne no_cntrh_max
  clr  cntrh
  inc  seconds
  cpi  seconds, 60
  brne not_s60
  clr  seconds
  inc  minutes
  cpi  minutes, 60
  brne not_m60
  clr  minutes
  inc  hours
  cpi  hours, 24
  brne not_h24
  clr  hours
  inc  day_of_week
  cpi  day_of_week, 8
  brne not_dow_8
  ldi  day_of_week, 1
not_dow_8:
not_m60:
not_h24:
not_s60:
  cp   minutes, alarmm
  brne no_alarm
  cp   hours, alarmh
  brne no_alarm
  cpi  day_of_week, 6 ; alarm only for days 1..5
  brsh no_alarm

  tst alarm_melody_length_low
  brne alarm_melody_in_progress
  tst alarm_melody_length_high
  brne alarm_melody_in_progress

; alarm init code
  ldi  ZL, low(2*alarm_melody)
  ldi  ZH, high(2*alarm_melody)
  lpm  alarm_melody_length_low, Z+
  lpm  alarm_melody_length_high, Z+
  movw YH:YL, ZH:ZL
  sbi PORTD, PORTD3 ; Turn ON amplifier

alarm_melody_in_progress:
no_cntrl_max:
no_cntrh_max:
no_alarm:
  cpi   mode, MODE_DISPLAY_OFF
  brne  no_phase4
  rcall phase4
  rjmp  out_done
no_phase4:
  clr  r16
  movw ZH:ZL, phase_table_high:phase_table_low
  add  ZL, cntrl
  adc  ZH, r16
  icall
out_done:
  pop r2
  pop r1
  pop r0
  pop r18
  pop r17
  pop r16
  pop ZH
  pop ZL
  out sreg, tmpSREG
  reti

temp_off0:
  sbi PORTB, PORTB5
  ret
temp_off1:
  sbi PORTB, PORTB6
  ret
phase4:
  clr r16
  sts PORTG, r16
  sbi PORTB, PORTB5
  sbi PORTB, PORTB6
  sbi PORTB, PORTB7

  tst cntrh
  breq adc_check
  ret
adc_check:
; adc check
  sbic ADCSRA, ADSC
  rjmp adc_not_ready
  mov  r16, adc_channel
  andi r16, 3
  brne not_ch_0
  ; channel 0 - temp sensor
.ifndef TEST
  in   templ, ADCL
  in   temph, ADCH
.else
  ldi  templ, low(ADC_MIN+9)
  ldi  temph, high(ADC_MIN+9)
.endif
  subi templ, low(ADC_MIN)
  sbci temph, high(ADC_MIN)
  rjmp adc_read_done
not_ch_0:
  ; channel 1 - vbat

; power check
  sbic PINF, PINF2
  rjmp power_ok
  ldi r16, low(phase_table_bat)
  mov phase_table_low, r16
  ldi r16, high(phase_table_bat)
  mov phase_table_high, r16
  ldi r16, PWM_STOP ; Normal port operation, OC0 disconnected.
  out TCCR0, r16
  rjmp power_check_done
power_ok:
  ldi r16, low(phase_table_normal)
  mov phase_table_low, r16
  ldi r16, high(phase_table_normal)
  mov phase_table_high, r16

  in   r16, ADCL
  in   r17, ADCH
  clc
  ror  r17
  ror  r16
  clc
  ror  r17
  ror  r16
  cpi  r16, VBAT_MAX/4
  brlo charge
  ldi r16, PWM_STOP ; Normal port operation, OC0 disconnected.
  out TCCR0, r16
  rjmp adc_read_done
charge:
  ldi r16, PWM_START ; Clear OC0 on Compare Match, set OC0 at BOTTOM, (non-inverting mode).
  out TCCR0, r16
power_check_done:
adc_read_done:
  inc adc_channel
  ldi r16, ADC_CHANNEL_2
  cp  adc_channel, r16
  brne no_ch_2
  andi r16, $FC
  mov  adc_channel, r16
no_ch_2:
  ; set ADC channel no
  out  ADMUX, adc_channel
  ; Start ADC
  sbi  ADCSRA, ADSC
adc_not_ready:
  ret

Start:
  ; Initialize the stack pointer
  ldi R24, low(RAMEND)	;  SP <-- RAMEND
  ldi R25, high(RAMEND)
  out SPL, R24
  out SPH, R25

  clr r16
  out PORTA, r16
  out PORTC, r16
  sts PORTG, r16
  out PORTD, r16
  sts PORTF, r16
  sts DDRF,  r16
  ldi r16,   8
  out DDRD,  r16
  ldi r16,   $E1
  out PORTB, r16
  ldi r16,   $F7
  out DDRB,  r16
  ldi r16,   3
  sts DDRG,  r16
  ser r16 ; r16 <= $FF
  out PORTE, r16
  out DDRE,  r16
  out DDRA,  r16
  ldi r16,   $7F
  out DDRC,  r16
;  ldi r16,   $0C
;  out PORTE, r16

  ; Configure ADC
  ; Reference - external
  ldi r16, ADC_CHANNEL_0
  mov adc_channel, r16
  out ADMUX, r16
  ; Enable ADC, set prescaler - 128 (ADC clk should be 50-200 khz)
  ldi r16, (1<<ADEN) | (1<<ADPS2) | (1<<ADPS1) | (1<<ADPS0)
  out ADCSRA, r16

  ; Configure WDT
  ldi r16, (1<<WDCE)|(1<<WDE)
  out WDTCR, r16
  ldi r16, (1<<WDCE)|(1<<WDE)
  out WDTCR, r16

  ; Enable sleep command, idle mode
  ldi r16, (1<<SE)
  out MCUCR, r16

  ; Enable SPI, Master, set clock rate fck/2
  sbi  SPSR, 0
  ldi  r17, (1<<SPE)|(1<<MSTR)
  out  SPCR, r17


  clr cntrh
  clr cntrl
  clr seconds
  clr minutes
  clr hours
  ldi day_of_week, 1
  clr alarmm
.ifdef TEST
  inc alarmm
  clr alarmh
  ldi seconds, 59
.else
  ldi r16, $80
  mov alarmh, r16
.endif
  clr alarm_melody_length_high
  clr alarm_melody_length_low

  clr temph
  clr templ

  clr receive_counter
  clr receive_blocked_counter_l
  clr receive_blocked_counter_h

  ldi r16, low(phase_table_normal)
  mov phase_table_low, r16
  ldi r16, high(phase_table_normal)
  mov phase_table_high, r16

  clr mode

  ldi r16, CORRECTION_VALUE
  mov correction_value_reg, r16

  clr r16
  out TCNT2, r16
  out TCNT0, r16
  ldi r16, T0CODE
  out OCR2, r16
  ; Timer 2 - clkI/O/8 (From prescaler), Clear Timer on Compare Match (CTC) Mode
  ldi r16, (1<<WGM21) | (1<<CS21)
  ; Start timer 2
  out  TCCR2, r16

  ; Enable Timer 2 interrupt
  ldi r16, 1<<OCIE2
  out TIMSK, r16

  ldi r16, PWMCODE
  out OCR0, r16
  ; Timer 0 - clkI/O (no prescaling), Fast PWM Mode
  ldi r16, PWM_STOP
  ; Start timer 0
  out TCCR0, r16

  sei
Sleep_:
.ifndef TEST
  sleep
.endif
  tst  receive_counter
  brmi Sleep_
  breq Sleep_
.include "hp_decoder.asm"
;  rjmp Sleep_

get_time_code:
  cpi mode, MODE_SET_ALARM_HOURS
  brsh no_clock_mode
  mov r0, minutes
  mov r2, hours
  rjmp get_code
no_clock_mode:
  mov r0, alarmm
  mov r16, alarmh
  andi r16, $7f
  mov r2, r16
get_code:
  lsl r0
  clr r1
  add ZL, r0
  adc ZH, r1
  clr r0
  clc
  ror r2
  ror r0
  add ZL, r0
  adc ZH, r2
  lpm r16, Z+
  lpm r17, Z
  ret

out_time0:
  ldi ZH, high(2*time0_codes)
  ldi ZL, low(2*time0_codes)
  rcall get_time_code
  sbrc seconds, 0
  ori r17, $20
  sbrs alarmh, 7 ; if alarm is on
  ori r17, $40
  out PORTA, r16
  out PORTC, r17
  ldi r16, 1
  sts PORTG, r16
  ret

out_time1:
  ldi ZH, high(2*time1_codes)
  ldi ZL, low(2*time1_codes)
  rcall get_time_code
  clr r18
  sts PORTG, r18
  out PORTA, r16
  out PORTC, r17
  ldi r16, 2
  sts PORTG, r16
  ret

out_timetemp0:
  rcall out_time0
out_temp0:
  tst mode
  breq temp0_normal
  cpi mode, MODE_SET_ALARM_HOURS
  brsh alarm_mode2
  ldi  r16, $C6 ; C
  out PORTE, r16
  cbi PORTB, PORTB5
  ret
alarm_mode2:
  ldi  r16, $88 ; A
  out PORTE, r16
  cbi PORTB, PORTB5
  ret
temp0_normal:
  ldi ZH, high(2*temp0_codes)
  ldi ZL, low(2*temp0_codes)
  add ZL, templ
  adc ZH, temph
  lpm r16, Z
  out PORTE, r16
  cbi PORTB, PORTB5
  ret

out_temp1:
  tst mode
  breq temp1_normal
  cpi mode, MODE_SET_CORRECTION_VALUE
  breq set_corr_value_mode
  ldi  r16, $C7 ; L
  out PORTE, r16
  cbi PORTB, PORTB6
  ret
temp1_normal:
  ldi ZH, high(2*temp1_codes)
  ldi ZL, low(2*temp1_codes)
  add ZL, templ
  adc ZH, temph
  lpm r16, Z
  out PORTE, r16
  cbi PORTB, PORTB6
  ret
set_corr_value_mode:
  ldi ZH, high(2*seven_seg_codes2)
  ldi ZL, low(2*seven_seg_codes2)
  clr r16
  add ZL, correction_value_reg
  adc ZH, r16
  lpm r16, Z
  out PORTE, r16
  cbi PORTB, PORTB6
  ret

out_temp2:
  tst mode
  breq temp2_normal
  cpi mode, MODE_SET_CORRECTION_VALUE
  breq set_corr_value_mode2
  cpi mode, MODE_SET_CLOCK_HOURS
  breq show_H
  cpi mode, MODE_SET_ALARM_HOURS
  breq show_H
  cpi mode, MODE_SET_CLOCK_MINUTES
  breq show_n
  cpi mode, MODE_SET_ALARM_MINUTES
  breq show_n
  ldi ZH, high(2*seven_seg_codes)
  ldi ZL, low(2*seven_seg_codes)
  clr r16
  add ZL, day_of_week
  adc ZH, r16
  lpm r16, Z
  out PORTE, r16
  cbi PORTB, PORTB7
  ret
show_H:
  ldi  r16, $89 ; H
  out PORTE, r16
  cbi PORTB, PORTB7
  ret
show_n:
  ldi  r16, $AB ; n
  out PORTE, r16
  cbi PORTB, PORTB7
  ret
temp2_normal:
  ldi ZH, high(2*temp2_codes)
  ldi ZL, low(2*temp2_codes)
  add ZL, templ
  adc ZH, temph
  lpm r16, Z
  out PORTE, r16
  cbi PORTB, PORTB7
  ret
set_corr_value_mode2:
  ldi ZH, high(2*seven_seg_codes)
  ldi ZL, low(2*seven_seg_codes)
  clr r16
  add ZL, correction_value_reg
  adc ZH, r16
  lpm r16, Z
  out PORTE, r16
  cbi PORTB, PORTB7
  ret

button1_handler:
  tst mode
  brne display_on
  ldi mode, MODE_DISPLAY_OFF
  ret
display_on:
  clr mode
  ret

button2_handler:
  ldi r16, $80
  eor alarmh, r16
  ret

button3_handler:
  ldi mode, MODE_SET_CLOCK_HOURS
  ret

button4_handler:
  ldi mode, MODE_SET_CLOCK_MINUTES
  ret

button5_handler:
  ldi mode, MODE_SET_DAY_OF_WEEK
  ret

button6_handler:
  ldi mode, MODE_SET_ALARM_HOURS
  ret

button7_handler:
  ldi mode, MODE_SET_ALARM_MINUTES
  ret

button8_handler:
  ldi mode, MODE_SET_CORRECTION_VALUE
  ret

button9_handler:
  ret

button10_handler:
  ret

button11_handler:
  ret

button12_handler: ; 1
  ldi  r16, 1
  rjmp numeric_input

button13_handler: ; 2
  ldi  r16, 2
  rjmp numeric_input

button14_handler: ; 3
  ldi  r16, 3
  rjmp numeric_input

button15_handler: ; 4
  ldi  r16, 4
  rjmp numeric_input

button16_handler: ; 5
  ldi  r16, 5
  rjmp numeric_input

button17_handler: ; 6
  ldi  r16, 6
  rjmp numeric_input

button18_handler: ; 7
  ldi  r16, 7
  rjmp numeric_input

button19_handler: ; 8
  ldi  r16, 8
  rjmp numeric_input

button20_handler: ; 9
  ldi  r16, 9
  rjmp numeric_input

button21_handler:
  ret

button22_handler: ; 0
  clr  r16
numeric_input:
  cpi mode, MODE_SET_CLOCK_HOURS
  brne not_mode_1
  mov  r17, hours
  lsl  hours
  lsl  hours
  lsl  hours
  add  hours, r17
  add  hours, r17
  add  hours, r16
  cpi  hours, 24
  brlo hours_ok
  mov  hours, r16
hours_ok:
  ret
not_mode_1:
  cpi mode, MODE_SET_ALARM_HOURS
  brne not_mode_2
  mov  r17, alarmh
  lsl  alarmh
  lsl  alarmh
  lsl  alarmh
  add  alarmh, r17
  add  alarmh, r17
  add  alarmh, r16
  mov  r17, alarmh
  cpi  r17, 24
  brlo alarmh_ok
  mov  alarmh, r16
alarmh_ok:
  ret
not_mode_2:
  cpi mode, MODE_SET_DAY_OF_WEEK
  brne not_mode_3
  mov day_of_week, r16
  ret
not_mode_3:
  cpi mode, MODE_SET_CLOCK_MINUTES
  brne not_mode_4
  mov  r17, minutes
  lsl  minutes
  lsl  minutes
  lsl  minutes
  add  minutes, r17
  add  minutes, r17
  add  minutes, r16
  cpi  minutes, 60
  brlo minutes_ok
  mov  minutes, r16
minutes_ok:
  ret
not_mode_4:
  cpi mode, MODE_SET_ALARM_MINUTES
  brne not_mode_5
  mov  r17, alarmm
  lsl  alarmm
  lsl  alarmm
  lsl  alarmm
  add  alarmm, r17
  add  alarmm, r17
  add  alarmm, r16
  mov  r17, alarmm
  cpi  r17, 60
  brlo alarmm_ok
  mov  alarmm, r16
alarmm_ok:
  ret
not_mode_5:
  cpi mode, MODE_SET_CORRECTION_VALUE
  brne not_mode_6
  mov  r17, correction_value_reg
  lsl  correction_value_reg
  lsl  correction_value_reg
  lsl  correction_value_reg
  add  correction_value_reg, r17
  add  correction_value_reg, r17
  add  correction_value_reg, r16
  mov  r17, correction_value_reg
  cpi  r17, 50
  brlo correction_value_ok
  mov  correction_value_reg, r16
correction_value_ok:
  ret
not_mode_6:
  ret

button23_handler:
  ret

seven_seg_codes:
.db $C0, $F9, $A4, $B0, $99, $92, $82, $F8, $80, $90
.db $C0, $F9, $A4, $B0, $99, $92, $82, $F8, $80, $90
.db $C0, $F9, $A4, $B0, $99, $92, $82, $F8, $80, $90
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.db $C0, $F9, $A4, $B0, $99, $92, $82, $F8, $80, $90

seven_seg_codes2:
.db $C0,$C0,$C0,$C0,$C0,$C0,$C0,$C0,$C0,$C0
.db $F9,$F9,$F9,$F9,$F9,$F9,$F9,$F9,$F9,$F9
.db $A4,$A4,$A4,$A4,$A4,$A4,$A4,$A4,$A4,$A4
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.db $90,$90,$90,$90,$90,$90,$90,$90,$90,$90

.include "phase_table.asm"

time0_codes:
.dw 7157,501,4085,3573,5621,7669,8181,501,8181,7669,7093,437,4021,3509,5557,7605
.dw 8117,437,8117,7605,6901,245,3829,3317,5365,7413,7925,245,7925,7413,7157,501
.dw 4085,3573,5621,7669,8181,501,8181,7669,7093,437,4021,3509,5557,7605,8117,437
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.dw 8064,7552,6976,320,3904,3392,5440,7488,8000,320,8000,7488,0,0,0,0

time1_codes:
.dw 8056,3960,6008,8056,3960,7032,7032,8056,8056,8056,7224,3128,5176,7224,3128,6200
.dw 6200,7224,7224,7224,8120,4024,6072,8120,4024,7096,7096,8120,8120,8120,7608,3512
.dw 5560,7608,3512,6584,6584,7608,7608,7608,7416,3320,5368,7416,3320,6392,6392,7416
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.dw 23774,23774,24030,19934,21982,24030,19934,23006,23006,24030,24030,24030,0,0,0,0

; code for temp 40 is 374
temp0_codes:
.db 153,176,176,176,176,176,176,176,176,176,176,176,176,176,176,176
.db 176,176,176,176,176,176,176,176,176,176,176,176,176,176,176,176
.db 176,176,176,176,176,176,176,176,176,176,176,176,176,176,176,176
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.db 255,255,255,255,255,255,255,255,255,255,255,255,255,255,255

temp1_codes:
.db 64,16,16,16,16,16,16,16,16,0,0,0,0,0,0,0
.db 0,0,120,120,120,120,120,120,120,120,2,2,2,2,2,2
.db 2,2,2,18,18,18,18,18,18,18,18,18,25,25,25,25
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.db 121,121,121,121,121,121,121,64,64,64,64,64,64,64,64

temp2_codes:
.db 192,144,248,130,146,153,176,249,192,144,128,248,146,153,176,164
.db 249,192,128,248,130,146,153,176,164,192,144,128,248,130,146,176
.db 164,249,192,144,128,248,130,153,176,164,249,192,144,128,248,146
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.db 130,146,153,176,164,249,192,144,128,248,146,153,176,164,249

button_codes:
.db 23, 0
; row1
.db 0,132,24, 20
.dw button1_handler
.db 0,68,24,27
.dw button2_handler
.db 0,68,216,0
.dw button3_handler
.db 0,68,216,32
.dw button4_handler
.db 0,68,24,52
.dw button5_handler
; row2
.db 0,132,24,54
.dw button6_handler
.db 0,68,24,42
.dw button7_handler
.db 0,68,24,62
.dw button8_handler
.db 0,68,152,38
.dw button9_handler
.db 0,132,24,30
.dw button10_handler
; row3
.db 0,68,24,22
.dw button11_handler
.db 0,132,24,26
.dw button12_handler
.db 0,132,24,34
.dw button13_handler
.db 0,68,24,58
.dw button14_handler
; row4
.db 0,132,24,3
.dw button15_handler
.db 0,68,24,51
.dw button16_handler
.db 0,68,24,35
.dw button17_handler
; row5
.db 0,132,24,19
.dw button18_handler
.db 0,132,24,2
.dw button19_handler
.db 0,68,24,4
.dw button20_handler
; row6
.db 0,132,24,38
.dw button21_handler
.db 0,132,24,36
.dw button22_handler
.db 0,68,24,6
.dw button23_handler

.ifdef TEST
alarm_melody:
  .dw 5 ; alarm_melody_length
  .db 0, 4, 16, 64, 255 
.else
.include "alarm_melody.asm"
.endif
